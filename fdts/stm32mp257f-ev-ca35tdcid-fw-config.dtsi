// SPDX-License-Identifier: (GPL-2.0-or-later OR BSD-3-Clause)
/*
 * Copyright (C) STMicroelectronics 2022 - All Rights Reserved
 */

/*
 * STM32MP25 tf-a firmware config
 * Project : eco
 * Generated by XLmx tool version 2.2 - 3/8/2023 2:34:26 PM
 */

&st_mem_firewall {
	bl31_context: bl31-context@81ff0000 {
		compatible = "shared-dma-pool";
		reg = <0x00000000 0x81ff0000 0x00000000 0x10000>;
		st,protreg = <RISAFPROT(RISAF_REG_ID(7), RIF_CID1_BF, RIF_CID1_BF, RIF_CID1_BF, RIF_SEC, RIF_ENC_EN, RIF_BREN_EN)>;
	};
	op_tee: op-tee@82000000 {
		compatible = "shared-dma-pool";
		reg = <0x00000000 0x82000000 0x00000000 0x2000000>;
		st,protreg = <RISAFPROT(RISAF_REG_ID(8), RIF_CID1_BF, RIF_CID1_BF, 0, RIF_SEC, RIF_ENC_EN, RIF_BREN_EN)>;
	};
};
